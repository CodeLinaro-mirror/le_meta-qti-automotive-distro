## conf/distro/auto-gvm-headless.conf
```bitbake
require conf/distro/include/auto-common.inc

DISTRO_NAME = "auto gvm headless"

PRODUCT = "${MACHINE}-headless"
PRODUCT:gvm-gen4-5 = "gvm-gen4-5-hl"
PRODUCT:quin-gvm-gen4-5 = "gvm-gen4-5-hl"

DEPLOY_NAME_BASE:gvm-gen4-5 = "${PRODUCT}"
DEPLOY_NAME_BASE:quin-gvm-gen4-5 = "${PRODUCT}"

DISTRO_FEATURES:remove = " wifi"

DISTRO_FEATURES:append = " \
    qti-core \
    qti-data \
    qti-extra \
    qti-graphics \
    qti-hypervisor \
    qti-security \
    qti-avb \
    qti-fde \
    qti-tools \
    ab-boot-support \
"

# Preferred refpolicy
PREFERRED_PROVIDER_virtual/refpolicy = "refpolicy-targeted"
DEFAULT_ENFORCING = "enforcing"

DISTRO_FEATURES:remove:gvm-gen4-5 = " \
    qti-extra \
    qti-graphics \
    qti-bluetooth \
"

DISTRO_FEATURES:remove:quin-gvm-gen4-5 = " \
    qti-extra \
    qti-graphics \
    qti-bluetooth \
"
```

## conf/distro/auto-gvm.conf
```bitbake
require conf/distro/include/auto-common.inc

DISTRO_NAME = "auto gvm"

DISTRO_FEATURES:append = " \
    qti-adsp \
    qti-audio \
    qti-audio-ar \
    qti-audio-awe \
    qti-camera \
    qti-cdsp \
    qti-cdsp1 \
    qti-core \
    qti-data \
    qti-display \
    qti-extra \
    qti-graphics \
    qti-multimedia \
    qti-security \
    qti-vnw \
    qti-tools \
    qti-avb \
    qti-fde \
    qti-fastcv \
    ab-boot-support \
"

DISTRO_FEATURES:remove:gvm-gen5 = "\
    qti-audio \
    qti-audio-ar \
"

DISTRO_FEATURES:remove:qclinux-gvm-gen5 = "\
    qti-audio \
    qti-audio-ar \
    qti-multimedia \
    qti-display \
    qti-camera \
"

DISTRO_FEATURES:remove:gvm-gen4-5 = "\
    qti-adsp \
    qti-audio \
    qti-audio-ar \
    qti-camera \
    qti-cdsp \
    qti-cdsp1 \
    qti-display \
    qti-graphics \
    qti-multimedia \
    qti-security \
    qti-vnw \
    qti-fastcv \
"

# Video
DISTRO_FEATURES:append:gvm-gen5 = " qti-codec2 qti-gstdeinterlace"

# Camera
DISTRO_FEATURES:append:gvm-gen5 = " qti-qcx"

# Switch package format to rpm for GVM
PACKAGE_CLASSES = "package_rpm"
```

## conf/distro/auto.conf
```bitbake
require conf/distro/include/auto-common.inc

DISTRO_NAME = "auto"
AUTOMOTIVE_PATH = "automotive"

#TODO: cleanup or rename qti-xxx DISTRO_FEATURES.
DISTRO_FEATURES:append = " \
    qti-adsp \
    qti-audio \
    qti-bluetooth \
    qti-fastcv \
    qti-audio-ar \
    qti-camera \
    qti-cdsp \
    qti-core \
    qti-data \
    qti-display \
    qti-extra \
    qti-graphics \
    qti-ml \
    qti-multimedia \
    qti-cv \
    qti-security \
    qti-tools \
    qti-vnw \
    qti-location \
    qti-avb \
    ab-boot-support \
    qti-wlan \
    qti-compute-platform \
    qti-rideware \
    qti-qcnode \
"

DISTRO_FEATURES:remove = "\
    qti-location \
    early-eth \
"

DISTRO_FEATURES:append:sa8797 = " \
    qti-audio-aw \
"

DISTRO_FEATURES:remove:sa8797 = " \
    qti-adsp \
    qti-audio \
    qti-audio-ar \
    qti-fastcv \
    qti-cdsp \
    qti-extra \
    qti-ml \
    qti-location \
"

DISTRO_FEATURES:remove:sa8797dc = " \
    qti-adsp \
    qti-audio \
    qti-bluetooth \
    qti-fastcv \
    qti-audio-ar \
    qti-camera \
    qti-cdsp \
    qti-data \
    qti-display \
    qti-extra \
    qti-graphics \
    qti-ml \
    qti-multimedia \
    qti-security \
    qti-tools \
    qti-vnw \
    qti-location \
    qti-avb \
    qti-wlan \
    ab-boot-support acl alsa bluetooth debuginfod ext2 pcmcia usbgadget usbhost nfs zeroconf pci 3g nfc vfat pam seccomp selinux \
"
```

## conf/distro/include/auto-common.inc
```bitbake
require conf/distro/include/security_flags.inc

require conf/distro/include/distro_features.inc

require conf/distro/include/non-gplv3-license.inc

require conf/distro/include/base.inc

DISTRO_NAME = "automotive"
DISTROOVERRIDES =. "automotive:"
# Support SDP
ID_LIKE = "automotive"

PRODUCT ?= "${MACHINE}" 
DEPLOY_NAME_BASE = "${PRODUCT}-automotive"
IMAGE_NAME = "${IMAGE_BASENAME}-${PRODUCT}${IMAGE_VERSION_SUFFIX}"
IMAGE_LINK_NAME = "${IMAGE_BASENAME}-${PRODUCT}"

PERSIST_IMAGE_ROOTFS_SIZE ?= "128M"

VIRTUAL-RUNTIME_dev_manager = "udev"
VIRTUAL-RUNTIME_init_manager = "systemd"

IMAGE_FEATURES:append = " read-only-rootfs"

LICENSE_FLAGS_ACCEPTED += "commercial_gstreamer1.0-libav commercial_gstreamer1.0-omx"
LICENSE_FLAGS_ACCEPTED += "commercial_gstreamer1.0-plugins-ugly commercial_opencore-amr"
LICENSE_FLAGS_ACCEPTED += "commercial_ffmpeg"

ERROR_QA:remove:sa8775 = "patch-fuzz"

# In Scarthgap, there is currently not "ignore .debug files", So skip this QA check to avoid too many build warnings.
WARN_QA:remove = "buildpaths"

# include ${DISTRO_INC_FILES}

# Sizes for EXT4 (in bytes)
SYSTEM_SIZE_EXT4 ?= "100000000"
SYSTEMRW_SIZE_EXT4 ?= "8388608"
USERDATA_SIZE_EXT4 ?= "2000000000"
CACHE_SIZE_EXT4 ?= "80000000"
PERSIST_IMAGE_ROOTFS_SIZE ?= "128M"

BB_DANGLINGAPPENDS_WARNONLY = "yes"

#Align with poky/meta-poky/conf/distro/poky.conf
OE_VERSION ?= "4.0.7"
```

## conf/distro/include/distro_features.inc
```bitbake
# Support systemd-user-session
DISTRO_FEATURES:append = " pam"

# Disable pulseaudio
DISTRO_FEATURES_BACKFILL_CONSIDERED:append:gen5 = " pulseaudio"

# Display
DISTRO_FEATURES:append = " wayland"

DISTRO_FEATURES:append = " opengl"

#Enable persist-image
DISTRO_FEATURES:append = " persist-image "

DISTRO_FEATURES:append = " qti-early-eth"
#DISTRO_FEATURES:append = " early_init"
#DISTRO_FEATURES:append = " early_userspace"


DISTRO_FEATURES:append = " hibernation"

# Use systemd init manager.
DISTRO_FEATURES:append = " systemd ${@bb.utils.contains('LAYERSERIES_CORENAMES', 'scarthgap', 'usrmerge', '', d)}"
DISTRO_FEATURES_BACKFILL_CONSIDERED += "sysvinit"

DISTRO_FEATURES:append = " vulkan"

# WLAN
DISTRO_FEATURES:append = " qti-wlan wifi"
DISTRO_FEATURES:remove:gen5 = "wifi"


# SELinux
DISTRO_FEATURES:append:gen5 = " selinux"
DISTRO_FEATURES_NATIVE:append:gen5 = " selinux"
DISTRO_FEATURES:append:sa8775 = " selinux"
DISTRO_FEATURES_NATIVE:append:sa8775 = " selinux"
DISTRO_FEATURES:append:sa7255 = " selinux"
DISTRO_FEATURES_NATIVE:append:sa7255 = " selinux"

# Preferred sepolicy
PREFERRED_PROVIDER_virtual/refpolicy:gen5 = "selinux-policy"
DEFAULT_ENFORCING:gen5 = "enforcing"
PREFERRED_PROVIDER_virtual/refpolicy:sa8775 = "selinux-policy"
DEFAULT_ENFORCING:sa8775 = "enforcing"
PREFERRED_PROVIDER_virtual/refpolicy:sa7255 = "selinux-policy"
DEFAULT_ENFORCING:sa7255 = "enforcing"

DISTRO_FEATURES:remove:pn-core-image-minimal = "selinux"

# Disable QCLinux Yocto Unused Distro
DISTRO_FEATURES:remove = "x11 nfs"

# Virtiofsd
DISTRO_FEATURES:append = " seccomp"

# Video
DISTRO_FEATURES:append:gen5 = " qti-gstdeinterlace"
```

## conf/distro/include/non-gplv3-license.inc
```bitbake
# Eliminate gpl3 gdbm dependency
PACKAGECONFIG:remove:pn-perl = "gdbm"
PACKAGECONFIG:remove:pn-python3 = "gdbm"

# Eliminate gpl3 kbd-keymaps-pine dependency
RRECOMMENDS:${PN}-keymaps:remove:pn-kbd = "${PN}-keymaps-pine"

# Eliminate gpl3 readline dependency
PACKAGECONFIG:remove:pn-nftables = "readline"

IMAGE_INSTALL:remove:pn-machine-image = "rt-tests"
IMAGE_INSTALL:remove:pn-early-ramdisk-image = "rt-tests"

# Eliminate gpl3 bash dependency
RDEPENDS:${PN}:remove:pn-alsa-utils = "alsa-utils-scripts"

# Eliminate gpl3 dependency duo to selinux
RDEPENDS:${PN}:remove:pn-packagegroup-selinux-minimal = "coreutils"
RDEPENDS:${PN}:remove:pn-selinux-init = "coreutils"
RDEPENDS:${PN}:remove:pn-selinux-labeldev = "coreutils"
RDEPENDS:${PN}-sepolicy:remove:pn-selinux-python = "binutils"
RDEPENDS:${PN}-fixfiles:remove:pn-policycoreutils = "grep findutils"


EXTRA_IMAGE_FEATURES:remove:pn-machine-image = "package-management"
```
